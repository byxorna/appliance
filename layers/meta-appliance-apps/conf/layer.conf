## layers/meta-appliance-apps/conf/layer.conf
```bitbake
# We have a conf and classes directory, set up via BBPATH
BBPATH .= ":${LAYERDIR}"

# We have recipes-* directories, add to BBFILES
BBFILES += "${LAYERDIR}/recipes-*/*/*.bb \
            ${LAYERDIR}/recipes-*/*/*.bbappend"

BBFILE_COLLECTIONS += "meta-appliance-apps"
BBFILE_PATTERN_meta-appliance-apps = "^${LAYERDIR}/"
BBFILE_PRIORITY_meta-appliance-apps = "10"

LAYERDEPENDS_meta-appliance-apps = "meta-appliance-os"
LAYERSERIES_COMPAT_meta-appliance-apps = "scarthgap"
```

## layers/meta-appliance-audio/conf/layer.conf
```bitbake
# We have a conf and classes directory, set up via BBPATH
BBPATH .= ":${LAYERDIR}"

# We have recipes-* directories, add to BBFILES
BBFILES += "${LAYERDIR}/recipes-*/*/*.bb \
            ${LAYERDIR}/recipes-*/*/*.bbappend"

BBFILE_COLLECTIONS += "meta-appliance-audio"
BBFILE_PATTERN_meta-appliance-audio = "^${LAYERDIR}/"
BBFILE_PRIORITY_meta-appliance-audio = "10"

LAYERDEPENDS_meta-appliance-audio = "meta-appliance-os multimedia-layer"
LAYERSERIES_COMPAT_meta-appliance-audio = "scarthgap"
```

## layers/meta-appliance-bsp-mycroft-mkii-rpi-devkit/conf/layer.conf
```bitbake
# Mark II BSP layer — hardware-specific recipes for the Mycroft Mark II DevKit
# (RPi4 + SJ201 daughterboard). Depends only on meta-raspberrypi; the Mark II
# is a standard RPi4 with a well-documented daughterboard, so no
# meta-seeed-cm4 dependency is needed.

BBPATH .= ":${LAYERDIR}"

BBFILES += "${LAYERDIR}/recipes-*/*/*.bb \
            ${LAYERDIR}/recipes-*/*/*.bbappend"

BBFILE_COLLECTIONS += "meta-appliance-bsp-mycroft-mkii-rpi-devkit"
BBFILE_PATTERN_meta-appliance-bsp-mycroft-mkii-rpi-devkit = "^${LAYERDIR}/"
BBFILE_PRIORITY_meta-appliance-bsp-mycroft-mkii-rpi-devkit = "10"

LAYERDEPENDS_meta-appliance-bsp-mycroft-mkii-rpi-devkit = "raspberrypi"
LAYERSERIES_COMPAT_meta-appliance-bsp-mycroft-mkii-rpi-devkit = "scarthgap"

# Enable kernel console on the DSI framebuffer so the display shows a
# login prompt.
CMDLINE:append = " console=tty1"

# Read-only rootfs (belt-and-suspenders with fstab ro mount option)
CMDLINE:append = " ro"
```

## layers/meta-appliance-bsp-mycroft-mkii-rpi-devkit/conf/machine/mycroft-mkii-rpi-devkit.conf
```bitbake
#@TYPE: Machine
#@NAME: Mycroft Mark II DevKit
#@DESCRIPTION: Raspberry Pi 4B with SJ201 daughterboard (XMOS XVF-3510 DSP,
#              TAS5806MD amplifier, Waveshare 4.3" DSI display, GPIO buttons).

require conf/machine/raspberrypi4-64.conf

# I2C for TAS5806MD, XMOS control, GT911 touch
ENABLE_I2C = "1"
# SPI for XMOS firmware upload
ENABLE_SPI_BUS = "1"
# UART for debug console
ENABLE_UART = "1"
# Autoload i2c-dev for userspace I2C access (tas5806-init, xvf3510-flash)
KERNEL_MODULE_AUTOLOAD:rpi += "i2c-dev"
```

## layers/meta-appliance-bsp-raspberrypi/conf/layer.conf
```bitbake
# Shared BSP layer for vanilla Raspberry Pi machines (Pi 2B, Pi 3B, Pi 4B,
# Pi Zero 2 W). Provides the appliance partition layout (WKS) and fstab.
# No custom DT overlays, config.txt appends, or codec drivers.

BBPATH .= ":${LAYERDIR}"

BBFILES += "${LAYERDIR}/recipes-*/*/*.bb \
            ${LAYERDIR}/recipes-*/*/*.bbappend"

BBFILE_COLLECTIONS += "meta-appliance-bsp-raspberrypi"
BBFILE_PATTERN_meta-appliance-bsp-raspberrypi = "^${LAYERDIR}/"
BBFILE_PRIORITY_meta-appliance-bsp-raspberrypi = "10"

LAYERDEPENDS_meta-appliance-bsp-raspberrypi = "raspberrypi"
LAYERSERIES_COMPAT_meta-appliance-bsp-raspberrypi = "scarthgap"

# Read-only rootfs (belt-and-suspenders with fstab ro mount option)
CMDLINE:append = " ro"
```

## layers/meta-appliance-devtools/conf/layer.conf
```bitbake
BBPATH .= ":${LAYERDIR}"

BBFILES += "${LAYERDIR}/recipes-*/*/*.bb \
            ${LAYERDIR}/recipes-*/*/*.bbappend"

BBFILE_COLLECTIONS += "meta-appliance-devtools"
BBFILE_PATTERN_meta-appliance-devtools = "^${LAYERDIR}/"
BBFILE_PRIORITY_meta-appliance-devtools = "10"

LAYERDEPENDS_meta-appliance-devtools = "meta-appliance-os"
LAYERSERIES_COMPAT_meta-appliance-devtools = "scarthgap"
```

## layers/meta-appliance-os/conf/distro/appliance-os.conf
```bitbake
# appliance-os distro configuration
#
# Thin wrapper around poky for single-purpose appliance images.
# Switches to systemd, drops desktop/mobile features not needed
# on a headless-ish embedded device with a fixed UI.

require conf/distro/poky.conf

DISTRO = "appliance-os"
DISTRO_NAME = "Appliance OS"
APPLIANCE_VERSION ?= "0.0.0-unknown"
DISTRO_VERSION = "${APPLIANCE_VERSION}"

# --- os-release branding ---------------------------------------------------
# Populates /etc/os-release (and the login banner via base-files).
# VARIANT and VARIANT_ID are set from the APPLIANCE_VARIANT env var passed
# by kas from the Makefile (e.g. "reterminal-hifi").
APPLIANCE_VARIANT ?= "unknown"
ID_LIKE = "poky"
VARIANT = "${APPLIANCE_VARIANT}"
VARIANT_ID = "${APPLIANCE_VARIANT}"
APPLIANCE_HOME_URL ?= ""
APPLIANCE_BUG_REPORT_URL ?= ""
HOME_URL = "${APPLIANCE_HOME_URL}"
BUG_REPORT_URL = "${APPLIANCE_BUG_REPORT_URL}"
OS_RELEASE_FIELDS:append = " VARIANT VARIANT_ID HOME_URL BUG_REPORT_URL BUILD_ID"

# --- init system -----------------------------------------------------------
INIT_MANAGER = "systemd"
DISTRO_FEATURES:append = " systemd"
DISTRO_FEATURES:remove = "sysvinit"
VIRTUAL-RUNTIME_init_manager = "systemd"
VIRTUAL-RUNTIME_initscripts = "systemd-compat-units"
VIRTUAL-RUNTIME_login_manager = "shadow-base"

# --- PAM (required by weston-init for autologin) --------------------------
DISTRO_FEATURES:append = " pam"

# --- static UID/GID assignment ---------------------------------------------
# Pin all service-account UIDs/GIDs so file ownership on the persistent /data
# partition stays correct after A/B rootfs updates.  Without stable IDs a UID
# allocated dynamically in slot A could map to a different user in slot B.
# Assignments live in layers/meta-appliance-os/files/{passwd,group}.
USERADDEXTENSION = "useradd-staticids"
USERADD_ERROR_DYNAMIC = "error"

# --- RAUC A/B updates ------------------------------------------------------
DISTRO_FEATURES:append = " rauc"

# --- strip features we don't need ------------------------------------------
DISTRO_FEATURES:remove = " \
    3g \
    nfc \
    x11 \
    nfs \
    pulseaudio \
    ptest \
    debuginfod \
    zeroconf \
"

# --- keep these explicitly --------------------------------------------------
# alsa bluetooth wifi wayland vulkan opengl ipv4 ipv6 vfat ext2 seccomp acl
# xattr pci ldconfig gobject-introspection-data multiarch
```

## meta-appliance-app-feishin/conf/layer.conf
```bitbake
# We have a conf and classes directory, set up via BBPATH
BBPATH .= ":${LAYERDIR}"

# We have recipes-* directories, add to BBFILES
BBFILES += "${LAYERDIR}/recipes-*/*/*.bb \
            ${LAYERDIR}/recipes-*/*/*.bbappend"

BBFILE_COLLECTIONS += "meta-appliance-app-feishin"
BBFILE_PATTERN_meta-appliance-app-feishin = "^${LAYERDIR}/"
BBFILE_PRIORITY_meta-appliance-app-feishin = "10"

LAYERDEPENDS_meta-appliance-app-feishin = ""
LAYERSERIES_COMPAT_meta-appliance-app-feishin = "scarthgap"
```

## meta-appliance-bsp-reterminal/conf/layer.conf
```bitbake
# reTerminal BSP layer — hardware-specific recipes for the Seeed reTerminal (CM4).
# Depends on meta-raspberrypi (rpi-config) and meta-seeed-cm4 (machine, dtoverlays).

BBPATH .= ":${LAYERDIR}"

BBFILES += "${LAYERDIR}/recipes-*/*/*.bb \
            ${LAYERDIR}/recipes-*/*/*.bbappend"

BBFILE_COLLECTIONS += "meta-appliance-bsp-reterminal"
BBFILE_PATTERN_meta-appliance-bsp-reterminal = "^${LAYERDIR}/"
BBFILE_PRIORITY_meta-appliance-bsp-reterminal = "10"

LAYERDEPENDS_meta-appliance-bsp-reterminal = "raspberrypi meta-seeed-cm4"
LAYERSERIES_COMPAT_meta-appliance-bsp-reterminal = "scarthgap"

# meta-seeed-cm4's rpi-bootfiles bbappend downloads dt-blob-disp1-cam2.bin
# from datasheets.raspberrypi.org which is permanently 404. dt-blob.bin is a
# legacy mechanism; the reTerminal display is configured via DT overlays in
# config.txt. Mask the broken bbappend entirely.
BBMASK += "meta-seeed-cm4/recipes-bsp/bootfiles/rpi-bootfiles.bbappend"

# meta-seeed-cm4's image bbappends set a root password and pull in dev tools
# (vim, git, curl, tmux, etc.) that we don't want in the appliance image.
BBMASK += "meta-seeed-cm4/recipes-core/images/core-image-minimal.bbappend"
BBMASK += "meta-seeed-cm4/recipes-core/images/core-image-base.bbappend"

# meta-raspberrypi scarthgap's rpi-base.inc lists DT overlays that were added
# after 6.1 (Pi 5, DSI panel variants).  meta-seeed-cm4 pins the kernel to
# 6.1.y, so these .dts sources don't exist and the build fails.  Remove them
# at layer.conf scope so the fix is visible to both the kernel and image
# recipes (IMAGE_BOOT_FILES reads KERNEL_DEVICETREE at parse time).
KERNEL_DEVICETREE:remove = " \
    overlays/vc4-kms-dsi-ili9881-7inch.dtbo \
    overlays/vc4-kms-dsi-ili9881-5inch.dtbo \
    overlays/w1-gpio-pi5.dtbo \
    overlays/bcm2712d0.dtbo \
"

# The seeed-linux-dtoverlays recipe deploys its .dtbo files to DEPLOYDIR
# but meta-raspberrypi's IMAGE_BOOT_FILES only picks up overlays listed in
# KERNEL_DEVICETREE.  Add the Seeed overlays so they land in /boot/overlays/
# on the FAT partition where the RPi firmware can apply them.
IMAGE_BOOT_FILES:append = " reTerminal.dtbo;overlays/reTerminal.dtbo"

# meta-seeed-cm4's seeed-reterminal.conf omits i2c3 from
# RPI_KERNEL_DEVICETREE_OVERLAYS even though config.txt references it.
# Add it so the firmware can apply dtoverlay=i2c3,pins_4_5.
RPI_KERNEL_DEVICETREE_OVERLAYS:append = " overlays/i2c3.dtbo"

# Enable kernel console on the DSI framebuffer so the display shows a
# login prompt.
CMDLINE:append = " console=tty1"
```

## meta-appliance-os/conf/layer.conf
```bitbake
# We have a conf and classes directory, set up via BBPATH
BBPATH .= ":${LAYERDIR}"

# We have recipes-* directories, add to BBFILES
BBFILES += "${LAYERDIR}/recipes-*/*/*.bb \
            ${LAYERDIR}/recipes-*/*/*.bbappend"

BBFILE_COLLECTIONS += "meta-appliance-os"
BBFILE_PATTERN_meta-appliance-os = "^${LAYERDIR}/"
BBFILE_PRIORITY_meta-appliance-os = "10"

LAYERDEPENDS_meta-appliance-os = ""
LAYERSERIES_COMPAT_meta-appliance-os = "scarthgap"
```

## meta-appliance-os/conf/machine/appliance-reterminal.conf
```bitbake
# Product machine derived from Seeed reTerminal BSP.
#
# meta-seeed-cm4 pins the kernel to 6.1.y, but meta-raspberrypi scarthgap's
# rpi-base.inc lists DT overlays that were added after 6.1 (Pi 5, DSI panel
# variants). These don't have .dts sources in the 6.1 tree, so the kernel
# can't build them and they won't exist in DEPLOY_DIR_IMAGE.
#
# Because IMAGE_BOOT_FILES is derived from KERNEL_DEVICETREE via
# make_dtb_boot_files() at image-recipe parse time, this :remove must be at
# machine conf scope — a kernel bbappend only affects the kernel recipe's
# datastore, not the image recipe's.

require conf/machine/seeed-reterminal.conf

KERNEL_DEVICETREE:remove = " \
    overlays/vc4-kms-dsi-ili9881-7inch.dtbo \
    overlays/vc4-kms-dsi-ili9881-5inch.dtbo \
    overlays/w1-gpio-pi5.dtbo \
    overlays/bcm2712d0.dtbo \
"
```

## meta-kiosk-app-feishin/conf/layer.conf
```bitbake
# We have a conf and classes directory, set up via BBPATH
BBPATH .= ":${LAYERDIR}"

# We have recipes-* directories, add to BBFILES
BBFILES += "${LAYERDIR}/recipes-*/*/*.bb \
            ${LAYERDIR}/recipes-*/*/*.bbappend"

BBFILE_COLLECTIONS += "meta-kiosk-app-feishin"
BBFILE_PATTERN_meta-kiosk-app-feishin = "^${LAYERDIR}/"
BBFILE_PRIORITY_meta-kiosk-app-feishin = "10"

LAYERDEPENDS_meta-kiosk-app-feishin = ""
LAYERSERIES_COMPAT_meta-kiosk-app-feishin = "scarthgap"
```

## meta-kiosk-os/conf/layer.conf
```bitbake
# We have a conf and classes directory, set up via BBPATH
BBPATH .= ":${LAYERDIR}"

# We have recipes-* directories, add to BBFILES
BBFILES += "${LAYERDIR}/recipes-*/*/*.bb \
            ${LAYERDIR}/recipes-*/*/*.bbappend"

BBFILE_COLLECTIONS += "meta-kiosk-os"
BBFILE_PATTERN_meta-kiosk-os = "^${LAYERDIR}/"
BBFILE_PRIORITY_meta-kiosk-os = "10"

LAYERDEPENDS_meta-kiosk-os = ""
LAYERSERIES_COMPAT_meta-kiosk-os = "scarthgap"

# meta-seeed-cm4's rpi-bootfiles bbappend downloads dt-blob-disp1-cam2.bin
# from datasheets.raspberrypi.org which is permanently 404. dt-blob.bin is a
# legacy mechanism; the reTerminal display is configured via DT overlays in
# config.txt. Mask the broken bbappend entirely.
BBMASK += "meta-seeed-cm4/recipes-bsp/bootfiles/rpi-bootfiles.bbappend"
```
